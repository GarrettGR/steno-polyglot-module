## boards/shields/polyglot/Kconfig.defconfig
```kconfig
if SHIELD_POLYGLOT

config ZMK_KEYBOARD_NAME
    default "Polyglot"

endif # Name

if CHARACHORDER_ENGINE

config I2C
    default y

# probably have to configure a little more... TBD

endif # CCE
```
